## Documentation/devicetree/bindings/reset/socfpga-reset.txt
```
Altera SOCFPGA Reset Manager

Required properties:
- compatible : "altr,rst-mgr", "syscon";
                Note that syscon is invoked for this device to support the FPGA
		bridge driver and possibly other devices in the future.  See
		also Documentation/devicetree/bindings/mfd/syscon.txt
- reg : Should contain 1 register ranges(address and length)
- altr,modrst-offset : Should contain the offset of the first modrst register.
- #reset-cells: 1

Example:
	 rstmgr@ffd05000 {
		#reset-cells = <1>;
		compatible = "altr,rst-mgr", "syscon";
		reg = <0xffd05000 0x1000>;
		altr,modrst-offset = <0x10>;
	};
```

## drivers/staging/atsha204-i2c/Kconfig
```kconfig
config ATSHA204_I2C
	tristate "Driver for atmel ATSHA204A security eeprom"
	default n
	depends on I2C
	help
	  Driver for the Atmel ATSHA204A eeprom.

	  This driver provides a char device for random data and a sysfs for
	  configzone, serial number, otp, configzone_locked and datazone_locked

	  It will probably also work for ATSHA204, ATECC108, ATECC108A, ATECC508,
	  but this is untested
```
