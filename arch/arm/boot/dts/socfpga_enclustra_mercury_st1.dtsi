// SPDX-License-Identifier: (GPL-2.0+ OR MIT)
/*
 * Copyright (C) 2022 Enclustra GmbH
 * <info@enclustra.com>
 */

&i2c1 {
	si5338@70 {
		/* No driver available */
		compatible = "silabs,si5338";
		reg = <0x70>;
	};
};
