// SPDX-License-Identifier: GPL-2.0+ OR MIT
/*
 * Copyright (C) 2023 Enclustra GmbH - https://www.enclustra.com
 */

/ {
	model = "Mercury+ AA1";

	memory@0 {
		name = "memory";
		device_type = "memory";
		reg = <0x0 0x80000000>;
	};
};
