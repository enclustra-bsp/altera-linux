// SPDX-License-Identifier: GPL-2.0+ OR MIT
/*
 * Copyright (C) 2023 Enclustra GmbH - https://www.enclustra.com
 */

/ {
	model = "Enclustra Mercury+ AA1";
	compatible = "enclustra,mercury-aa1", "altr,socfpga-arria10", "altr,socfpga";

	memory@0 {
		name = "memory";
		device_type = "memory";
		reg = <0x0 0xC0000000>;
	};
};
